# STM32L4x3 register map
File version: 1.5
CPU: CM4 r0p1, little endian, MPU, FPU, 4 interrupt priority bits
Registers are 32-bit, read-write, reset 0x0 unless marked. A register's access mark holds for its fields unless they carry their own. Offsets are from the block's base; lines under a group give offsets from that group; [hi:lo] are bit positions; {n}, {i} and the like mark numbered series; 'fields as' and 'values as' point back to an identical list; <NAME> marks a mode.

## Memory map
0x40000000 TIM2 size 0x400 — General-purpose-timers
0x40001000 TIM6 size 0x400 — Basic-timers
0x40001400 TIM7 size 0x400
0x40002400 LCD size 0x400 — Liquid crystal display controller
0x40002800 RTC size 0x400 — Real-time clock
0x40002C00 WWDG size 0x400 — System window watchdog
0x40003000 IWDG size 0x400 — Independent watchdog
0x40003800 SPI2 size 0x400
0x40003C00 SPI3 size 0x400
0x40004400 USART2 size 0x400
0x40004800 USART3 size 0x400
0x40005400 I2C1 size 0x400 — Inter-integrated circuit
0x40005800 I2C2 size 0x400
0x40005C00 I2C3 size 0x400
0x40006000 CRS size 0x400 — Clock recovery system
0x40006400 CAN1 size 0x400 — Controller area network
0x40006C00 USB size 0x400 — Universal serial bus full-speed device interface
0x40007000 PWR size 0x400 — Power control
0x40007400 DAC1 size 0x400 — Digital-to-analog converter
0x40007800 OPAMP size 0x400 — Operational amplifiers
0x40007C00 LPTIM1 size 0x400 — Low power timer
0x40008000 LPUART1 size 0x400 — Universal synchronous asynchronous receiver transmitter
0x40008800 SWPMI1 size 0x400 — Single Wire Protocol Master Interface
0x40009400 LPTIM2 size 0x400
0x40010000 SYSCFG size 0x30 — System configuration controller
0x40010030 VREFBUF size 0x1D0 — Voltage reference buffer
0x40010200 COMP size 0x200 — Comparator
0x40010400 EXTI size 0x400 — External interrupt/event controller
0x40011C00 FIREWALL size 0x400
0x40012800 SDMMC size 0x400 — Secure digital input/output interface
0x40012C00 TIM1 size 0x400 — Advanced-timers
0x40013000 SPI1 size 0x400 — Serial peripheral interface/Inter-IC sound
0x40013800 USART1 size 0x400 — Universal synchronous asynchronous receiver transmitter
0x40014000 TIM15 size 0x400 — General purpose timers
0x40014400 TIM16 size 0x400 — General purpose timers
0x40015400 SAI1 size 0x400 — Serial audio interface
0x40020000 DMA1 size 0x400 — Direct memory access controller
0x40020400 DMA2 size 0x400
0x40021000 RCC size 0x400 — Reset and clock control
0x40022000 FLASH size 0x400
0x40023000 CRC size 0x400 — Cyclic redundancy check calculation unit
0x40024000 TSC size 0x400 — Touch sensing controller
0x48000000 GPIOA size 0x400 — General-purpose I/Os
0x48000400 GPIOB size 0x400 — General-purpose I/Os
0x48000800 GPIOC size 0x400 — General-purpose I/Os
0x48000C00 GPIOD size 0x400
0x48001000 GPIOE size 0x400
0x48001C00 GPIOH size 0x400
0x50040000 ADC1 size 0xB9 — Analog-to-Digital Converter
0x50040100 ADC2 size 0xB9
0x50040200 ADC3 size 0xB9
0x50040300 ADC123_Common size 0x11 — Analog-to-Digital Converter
0x50060000 AES size 0x400 — Advanced encryption standard hardware accelerator
0x50060800 RNG size 0x400 — Random number generator
0xE000E008 SCB_ACTRL size 0x5 — System control block ACTLR
0xE000E010 STK size 0x11 — SysTick timer
0xE000E100 NVIC size 0x356 — Nested Vectored Interrupt Controller
0xE000ED00 SCB size 0x41 — System control block
0xE000ED88 FPU_CPACR size 0x5 — Floating point unit CPACR
0xE000ED90 MPU size 0x15 — Memory protection unit
0xE000EF00 NVIC_STIR size 0x5 — Nested vectored interrupt controller
0xE000EF34 FPU size 0xD — Floting point unit
0xE0042000 DBGMCU size 0x15 — MCU debug component

## Interrupts
0 WWDG — Window Watchdog interrupt
1 PVD (EXTI) — PVD through EXTI line detection
2 TAMP_STAMP (RTC) — Tamper and TimeStamp interrupts
3 RTC_WKUP (RTC) — RTC Tamper or TimeStamp /CSS on LSE through EXTI line 19 interrupts
4 FLASH — Flash global interrupt
5 RCC — RCC global interrupt
6 EXTI0 (EXTI) — EXTI Line 0 interrupt
7 EXTI1 (EXTI) — EXTI Line 1 interrupt
8 EXTI2 (EXTI) — EXTI Line 2 interrupt
9 EXTI3 (EXTI) — EXTI Line 3 interrupt
10 EXTI4 (EXTI) — EXTI Line4 interrupt
11 DMA1_Channel1 (DMA1) — DMA1 Channel1 global interrupt
12 DMA1_Channel2 (DMA1) — DMA1 Channel2 global interrupt
13 DMA1_Channel3 (DMA1) — DMA1 Channel3 interrupt
14 DMA1_Channel4 (DMA1) — DMA1 Channel4 interrupt
15 DMA1_Channel5 (DMA1) — DMA1 Channel5 interrupt
16 DMA1_Channel6 (DMA1) — DMA1 Channel6 interrupt
17 DMA1_Channel7 (DMA1) — DMA1 Channel 7 interrupt
18 ADC1 — ADC1 and ADC2 global interrupt
19 CAN1_TX (CAN1) — CAN1 TX interrupts
20 CAN1_RX0 (CAN1) — CAN1 RX0 interrupts
21 CAN1_RX1 (CAN1) — CAN1 RX1 interrupts
22 CAN1_SCE (CAN1) — CAN1 SCE interrupt
23 EXTI9_5 (EXTI) — EXTI Line5 to Line9 interrupts
24 TIM15 — Timer 15 global interrupt
25 TIM16 — Timer 16 global interrupt
27 TIM1_CC (TIM1) — TIM1 Capture Compare interrupt
28 TIM2 — TIM2 global interrupt
31 I2C1_EV (I2C1) — I2C1 event interrupt
32 I2C1_ER (I2C1) — I2C1 error interrupt
33 I2C2_EV (I2C2) — I2C2 event interrupt
34 I2C2_ER (I2C2) — I2C2 error interrupt
35 SPI1 — SPI1 global interrupt
36 SPI2 — SPI2 global interrupt
37 USART1 — USART1 global interrupt
38 USART2 — USART2 global interrupt
39 USART3 — USART3 global interrupt
40 EXTI15_10 (EXTI) — EXTI Lines 10 to 15 interrupts
41 RTC_ALARM (RTC) — RTC alarms through EXTI line 18 interrupts
47 ADC3 — ADC3 global Interrupt
49 SDMMC — SDMMC global Interrupt
51 SPI3 — SPI3 global Interrupt
54 TIM6_DAC (TIM6) — TIM6 global and DAC1 and 2 underrun error interrupts
55 TIM7 — TIM7 global interrupt
56 DMA2_Channel1 (DMA2) — DMA2 Channel 1 global Interrupt
57 DMA2_Channel2 (DMA2) — DMA2 Channel 2 global Interrupt
58 DMA2_Channel3 (DMA2) — DMA2 Channel 3 global Interrupt
59 DMA2_Channel4 (DMA2) — DMA2 Channel 4 global Interrupt
60 DMA2_Channel5 (DMA2) — DMA2 Channel 5 global Interrupt
64 COMP — COMP1 and COMP2 interrupts
65 LPTIM1 — LP TIM1 interrupt
66 LPTIM2 — LP TIM2 interrupt
68 DMA2_Channel6 (DMA2) — DMA2 Channel 6 global Interrupt
69 DMA2_Channel7 (DMA2) — DMA2 Channel 7 global Interrupt
72 I2C3_EV (I2C3) — I2C3 event interrupt
73 I2C3_ER (I2C3) — I2C3 error interrupt
74 SAI1 — SAI1 global interrupt
76 SWPMI1 — SWPMI1 global interrupt
77 TSC — TSC global interrupt
78 LCD — LCD global interrupt
79 RNG — RNG global interrupt
80 CRS — CRS global interrupt
81 FPU — Floating point interrupt
