# STM32MP157x register map
File version: 1.3
Registers are 32-bit, read-write, reset 0x0 unless marked. A register's access mark holds for its fields unless they carry their own. Offsets are from the block's base; lines under a group give offsets from that group; [hi:lo] are bit positions; {n}, {i} and the like mark numbered series; 'fields as' and 'values as' point back to an identical list; <NAME> marks a mode.

## Memory map
0x40000000 TIM2 size 0x400
0x40001000 TIM3 size 0x400
0x40002000 TIM4 size 0x400
0x40003000 TIM5 size 0x400
0x40004000 TIM6 size 0x400
0x40005000 TIM7 size 0x400
0x40007000 TIM13 size 0x400
0x40008000 TIM14 size 0x400
0x40009000 LPTIM1 size 0x400
0x4000A000 WWDG1 size 0x400
0x4000B000 SPI2 size 0x400
0x4000C000 SPI3 size 0x400
0x4000D000 SPDIFRX size 0x400
0x4000E000 USART2 size 0x400
0x4000F000 USART3 size 0x400
0x40010000 UART4 size 0x400
0x40011000 UART5 size 0x400
0x40012000 I2C1 size 0x400
0x40013000 I2C2 size 0x400
0x40014000 I2C3 size 0x400
0x40015000 I2C5 size 0x400
0x40016000 HDMI_CEC size 0x400
0x40017000 DAC1 size 0x400
0x40018000 UART7 size 0x400
0x40019000 UART8 size 0x400
0x4001C000 MDIOS size 0x400
0x44000000 TIM1 size 0x400
0x44001000 TIM8 size 0x400
0x44003000 USART6 size 0x400
0x44004000 SPI1 size 0x400
0x44005000 SPI4 size 0x400
0x44006000 TIM15 size 0x400
0x44007000 TIM16 size 0x400
0x44008000 TIM17 size 0x400
0x44009000 SPI5 size 0x400
0x4400A000 SAI1 size 0x400 — SAI1 register block
0x4400B000 SAI2 size 0x400
0x4400C000 SAI3 size 0x400
0x4400D000 DFSDM1 size 0x800
0x4400E000 FDCAN1 size 0x400
0x4400F000 FDCAN2 size 0x400
0x44010000 CCU size 0x400
0x48000000 DMA1 size 0x400
0x48001000 DMA2 size 0x400
0x48002000 DMAMUX1 size 0x400
0x48003000 ADC size 0x100
0x48003100 ADC2 size 0x100
0x48003300 ADC_common size 0x100 — Analog-to-Digital Converter
0x48004000 SDMMC3 size 0x1000
0x48005000 DLYBSD3 size 0x1000
0x49000000 OTGHSFS1 size 0x1000
0x4C000000 HSEM size 0x400
0x4C001000 IPCC size 0x400
0x4C002000 HASH2 size 0x400 — HASH register block
0x4C003000 RNG2 size 0x400
0x4C004000 CRC2 size 0x1000
0x4C005000 CRYP2 size 0x400
0x4C006000 DCMI size 0x400
0x50000000 RCC size 0x1000
0x50001000 PWR size 0x400
0x50002000 GPIOA size 0x400
0x50003000 GPIOB size 0x400
0x50004000 GPIOC size 0x400
0x50005000 GPIOD size 0x400
0x50006000 GPIOE size 0x400
0x50007000 GPIOF size 0x400
0x50008000 GPIOG size 0x400
0x50009000 GPIOH size 0x400
0x5000A000 GPIOI size 0x400
0x5000B000 GPIOJ size 0x400
0x5000C000 GPIOK size 0x400
0x5000D000 EXTI size 0x400
0x50020000 SYSCFG size 0x400
0x50021000 LPTIM2 size 0x400
0x50022000 LPTIM3 size 0x400
0x50023000 LPTIM4 size 0x400
0x50024000 LPTIM5 size 0x400
0x50025000 VREFBUF size 0x400
0x50027000 SAI4 size 0x400
0x50028000 DTS size 0x400 — DTS register block
0x5002A000 HDP size 0x400
0x54001000 CRYP1 size 0x400
0x54002000 HASH1 size 0x400 — HASH register block
0x54003000 RNG1 size 0x400
0x54004000 GPIOZ size 0x400
0x57042024 AXIMC_Mx size 0x100000
0x58000000 MDMA size 0x1000 — MDMA1
0x58002000 FMC size 0x1000 — FMC register block
0x58003000 QUADSPI size 0x1000 — QUADSPI1
0x58004000 DLYBQS size 0x1000
0x58005000 SDMMC1 size 0x1000
0x58006000 DLYBSD1 size 0x1000
0x58007000 SDMMC2 size 0x1000
0x58008000 DLYBSD2 size 0x1000
0x58009000 CRC1 size 0x1000
0x5800A000 ETH_MAC_MMC size 0xBD4
0x5800AC00 ETH_MTL size 0x400
0x5800B000 ETH_DMA size 0x400
0x5A000000 DSIHOST1 size 0x800
0x5A001000 LTDC size 0x400
0x5A002000 IWDG2 size 0x400
0x5A003000 DDRCTRL size 0x1000
0x5A004000 DDRPHYC size 0x1000
0x5A005000 STGENR size 0x1000
0x5A006000 USBPHYC size 0x1000
0x5A007000 DDRPERFM size 0x400
0x5C000000 USART1 size 0x400 — Universal synchronous asynchronous receiver transmitter
0x5C001000 SPI6 size 0x400
0x5C002000 I2C4 size 0x400
0x5C003000 IWDG1 size 0x400
0x5C004000 RTC size 0x400
0x5C005000 BSEC size 0x1000 — BSEC2
0x5C006000 TZC size 0x1000
0x5C007000 ETZPC size 0x400
0x5C008000 STGENC size 0x1000
0x5C009000 I2C6 size 0x400
0x5C00A000 TAMP size 0x400
0xA0021000 GICD size 0x1000
0xA0022000 GICC size 0x2000
0xA0024000 GICH size 0x2000
0xA0026000 GICV size 0x2000
0xE000E100 NVIC size 0x401 — Nested Vectored Interrupt Controller

## Interrupts
0 WWDG1_IT (WWDG1) — Window Watchdog interrupt
1 PVD_AVD (EXTI) — PVD AND AVD detector through EXTI
2 TAMP — Tamper interrupt (include LSECSS interrupts)
3 RTC_WKUP_ALARM (RTC) — RTC Tamper or TimeStamp
4 TZC_IT (TZC) — TrustZone DDR address space controller
5 RCC — RCC global interrupt
6 EXTI0 (EXTI) — EXTI Line 0 interrupt
7 EXTI1 (EXTI) — EXTI Line 1 interrupt
8 EXTI2 (EXTI) — EXTI Line 2 interrupt
9 EXTI3 (EXTI) — EXTI Line 3 interrupt
10 EXTI4 (EXTI) — EXTI Line 4 interrupt
23 EXTI5 (EXTI) — EXTI line 5 interrupt
40 EXTI10 (EXTI) — EXTI line 10 interrupt
41 RTC_TS (RTC) — RTC timestamp interrupt
42 EXTI11 (EXTI) — EXTI line 11 interrupt
64 EXTI6 (EXTI) — EXTI line 6 interrupt
65 EXTI7 (EXTI) — EXTI line 7 interrupt
66 EXTI8 (EXTI) — EXTI line 8 interrupt
67 EXTI9 (EXTI) — EXTI line 9 interrupt
76 EXTI12 (EXTI) — EXTI line 12 interrupt
77 EXTI13 (EXTI) — EXTI line 13 interrupt
121 EXTI14 (EXTI) — EXTI line 14 interrupt
127 EXTI15 (EXTI) — EXTI line 15 interrupt
145 RCC_WAKEUP (RCC) — RCC MPU wakeup interrupt
197 TAMP_S (TAMP) — TAMP tamper secure interrupt
198 RTC_WKUP_ALARM_S (RTC) — RTC wakeup timer and alarms (A and B) secure interrupt
199 RTC_TS_S (RTC) — RTC timestamp secure interrupt
